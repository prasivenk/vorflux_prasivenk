AUTOSAR XML (schema 00051)
package /AUTOSAR_MemAcc/EcucModuleDefs
  module definition MemAcc [0..1]: post-build-variant-support=true  # AUTOSAR R24-11 Memory Access (MemAcc) Module Configuration
    container MemAccGeneral  # General configuration parameters for the MemAcc module
      boolean MemAccDevErrorDetect: default-value=true  # Enable/disable development error detection
      boolean MemAccVersionInfoApi: default-value=true  # Enable/disable MemAcc_GetVersionInfo API
      integer MemAccNumberOfAddressAreas: 1..16, default-value=2  # Number of configured address areas
      integer MemAccMainFunctionPeriod: 1..100, default-value=5  # MainFunction call period in ms
    container MemAccAddressAreaConfiguration [1..*]  # Per-address-area configuration
      integer MemAccAreaId: 0..15  # Unique address area identifier (0-based)
      integer MemAccStartAddress: 0..4294967295  # Physical start address of the address area
      integer MemAccLength: 1..4294967295  # Length of the address area in bytes
      integer MemAccSectorSize: 256..65536  # Erase sector size in bytes
      integer MemAccPageSize: 1..256  # Minimum write page size in bytes
    container MemAccPublishedInformation
      integer MemAccCompareBufferSize: default-value=32  # Internal buffer size for compare operations (bytes)
