AUTOSAR XML (schema 00051)
package /Fee_DefaultConfig
  module config Fee
    FeeGeneral:
      FeeDevErrorDetect = 1
      FeeVersionInfoApi = 1
      FeePollingMode = 1
      FeeSafetyEnable = 1
      FeeReadBackVerification = 1
      FeeVirtualPageSize = 32
      FeeMainFunctionPeriod = 5
      FeeNumberOfSectors = 4
      FeeSectorSize = 16384
      FeeMaxBlockSize = 512
      FeeGcRestartThreshold = 80
    8 x FeeBlockConfiguration, all with FeeNumberOfWriteCycles=0:
      FeeBlock_1: FeeBlockNumber=1, FeeBlockSize=32, FeeImmediateData=0
      FeeBlock_2: FeeBlockNumber=2, FeeBlockSize=64, FeeImmediateData=0
      FeeBlock_3: FeeBlockNumber=3, FeeBlockSize=128, FeeImmediateData=0
      FeeBlock_4: FeeBlockNumber=4, FeeBlockSize=256, FeeImmediateData=0
      FeeBlock_5: FeeBlockNumber=5, FeeBlockSize=16, FeeImmediateData=1
      FeeBlock_6: FeeBlockNumber=6, FeeBlockSize=8, FeeImmediateData=1
      FeeBlock_7: FeeBlockNumber=7, FeeBlockSize=512, FeeImmediateData=0
      FeeBlock_8: FeeBlockNumber=8, FeeBlockSize=64, FeeImmediateData=0
    FeePublishedInformation: FeeBlockOverhead=32
package /MemAcc_DefaultConfig
  module config MemAcc
    MemAccGeneral: MemAccDevErrorDetect=1, MemAccVersionInfoApi=1, MemAccNumberOfAddressAreas=2, MemAccMainFunctionPeriod=5
    MemAccArea_0_Fee (MemAccAddressAreaConfiguration): MemAccAreaId=0, MemAccStartAddress=2936012800, MemAccLength=65536, MemAccSectorSize=4096, MemAccPageSize=32
    MemAccArea_1_Bootloader (MemAccAddressAreaConfiguration): MemAccAreaId=1, MemAccStartAddress=2936078336, MemAccLength=16384, MemAccSectorSize=4096, MemAccPageSize=32
    MemAccPublishedInformation: MemAccCompareBufferSize=32
