AUTOSAR XML (schema 00051)
package /AUTOSAR_Fee/EcucModuleDefs
  module definition Fee [0..1]: post-build-variant-support=true  # AUTOSAR R24-11 Flash EEPROM Emulation (Fee) Module Configuration
    container FeeGeneral  # General configuration parameters for the Fee module
      boolean FeeDevErrorDetect: default-value=true  # Enable/disable development error detection
      boolean FeeVersionInfoApi: default-value=true  # Enable/disable Fee_GetVersionInfo API
      boolean FeePollingMode: default-value=true  # Enable/disable polling mode
      boolean FeeSafetyEnable: default-value=true  # Enable/disable safety checks (RAM CRC)
      boolean FeeReadBackVerification: default-value=true  # Enable/disable write read-back verification
      integer FeeVirtualPageSize: 8..256, default-value=32  # Virtual page size in bytes (TC3xx: 32)
      integer FeeMainFunctionPeriod: 1..100, default-value=5  # MainFunction call period in ms
      integer FeeNumberOfSectors: 2..16, default-value=4  # Number of configured sectors
      integer FeeSectorSize: 4096..65536, default-value=16384  # Sector size in bytes
      integer FeeMaxBlockSize: 1..4096, default-value=512  # Maximum block data size in bytes
      integer FeeGcRestartThreshold: 50..95, default-value=80  # GC restart fill threshold percentage
    container FeeBlockConfiguration [1..*]  # Per-block configuration
      integer FeeBlockNumber: 1..65534  # Unique block number (1-65534)
      integer FeeBlockSize: 1..4096  # Block data size in bytes
      boolean FeeImmediateData: default-value=false  # TRUE if this is an immediate-data block
      integer FeeNumberOfWriteCycles: 0..255, default-value=0  # Max write cycles (0 = unlimited)
    container FeePublishedInformation
      integer FeeBlockOverhead: default-value=32  # Per-block overhead in bytes (header size)
